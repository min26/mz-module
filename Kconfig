## Kconfig
```kconfig
# This Kconfig file is picked by zephyr build system.
# It is defined as a module Kconfig entry point (zephyr/module.yml)
#

rsource "drivers/Kconfig"
```

## boards/fmuk66/board.yml
```yaml
board:
  name: fmuk66
  full_name: FMUK66
  vendor: nxp
  socs:
    - name: mk66f18
```

## drivers/Kconfig
```kconfig
##
## Create new option in menuconfig


config M_GPIO
    bool "M GPIO DRIVER"
    default y       # Set enable by default
    depends on GPIO # Dependent on GPIO driver
    help
        Enable m_gpio driver
```

## drivers/button/Kconfig
```kconfig
## Create new option in menuconfig
config MG_BUTTON
    bool "MG-Button"
    default n       # Set disable by default
    depends on GPIO # Dependent on GPIO driver
    help
        Enable MG-Button driver
```

## drivers/gpio/Kconfig
```kconfig
##
## Create new option in menuconfig


config M_GPIO
    bool "M GPIO DRIVER"
    default n       # Set disable by default
    depends on GPIO # Dependent on GPIO driver
    help
        Enable m_gpio driver
```

## drivers/led/Kconfig
```kconfig
## Create new option in menuconfig
config MZ_LED
    bool "MZ-module, led"
    default n       # Set disable by default
    depends on GPIO # Dependent on GPIO driver
    help
        Enable MZ module, led driver
```

## drivers/switch/Kconfig
```kconfig
## Create new option in menuconfig
config MZ_BUTTON
    bool "MZ-module, Switch"
    default n       # Set disable by default
    depends on GPIO # Dependent on GPIO driver
    help
        Enable MZ module, switch driver
```

## drivers/timer/Kconfig
```kconfig
##
## Create new option in menuconfig


config M_TIMER
    bool "M TIMER DRIVER"
    default n       # Set disable by default
    help
        Enable timer workqueue
```

## drivers/usbcdc/Kconfig.usbcdc
```kconfig
# This file contains Kconfig options and defaults for configuring USB devices
# using the new experimental USB device support. The scope of these options is
# limited to USB samples in project tree, you cannot use them in your own
# application.

menu "USB DEVICE options"
	depends on USB_DEVICE_STACK_NEXT

config USB_DEVICE_MANUFACTURER
	string "USB device manufacturer string"
	default "Zephyr Project"
	help
	  USB device manufacturer string.

config USB_DEVICE_PRODUCT
	string "USB device product string"
	default "USB DEVICE"
	help
	  USB device product string.

config USB_DEVICE_VID
	hex "USB device Vendor ID"
	default 0x2fe3
	help
	  USB device sample Vendor ID. The default id (0x2fe3) is associated to
	  Zephyr Project, you must use your own VID for samples and applications
	  outside of Zephyr Project.

config USB_DEVICE_PID
	hex "USB device Product ID"
	default 0x0001
	help
	  USB device sample Product ID. You must use your own PID for samples
	  and applications outside of Zephyr Project.

config USB_DEVICE_SELF_POWERED
	bool "USB device Self-powered attribute"
	default y
	help
	  Set the Self-powered attribute in configuration.

config USB_DEVICE_REMOTE_WAKEUP
	bool "USB device Remote Wakeup attribute"
	help
	  Set the Remote Wakeup attribute in configuration.

config USB_DEVICE_MAX_POWER
	int "USB device bMaxPower value"
	default 125
	range 0 250
	help
	  bMaxPower value in configuration, in 2 mA units.

config USB_DEVICE_20_EXTENSION_DESC
	bool "Use default USB 2.0 Extension Descriptor"
	depends on USBD_BOS_SUPPORT
	help
	  Set bcdUSB value to 0201 and use default USB 2.0 Extension Descriptor.

endmenu
```

## drivers/usbd/Kconfig.usbd
```kconfig
# This file contains Kconfig options and defaults for configuring USB devices
# using the new experimental USB device support. 

menu "USBD options"
	depends on USB_DEVICE_STACK_NEXT

config M_USBD_MANUFACTURER
	string "USB device manufacturer string"
	default "Zephyr Project"
	help
	  USB device manufacturer string.

config M_USBD_PRODUCT
	string "USB device product string"
	default "USBD sample"
	help
	  USB device product stringa.

config M_USBD_VID
	hex "USB device Vendor ID"
	default 0x2fe3
	help
	  USB device Vendor ID. The default id (0x2fe3) is associated to
	  Zephyr Project, you must use your own VID for samples and applications
	  outside of Zephyr Project.

config M_USBD_PID
	hex "USB device Product ID"
	default 0x0001
	help
	  USB device Product ID. You must use your own PID for samples
	  and applications outside of Zephyr Project.

config M_USBD_SELF_POWERED
	bool "USB device Self-powered attribute"
	default y
	help
	  Set the Self-powered attribute in the configuration.

config M_USBD_REMOTE_WAKEUP
	bool "USB device Remote Wakeup attribute"
	help
	  Set the Remote Wakeup attribute in the configuration.

config M_USBD_MAX_POWER
	int "USB device bMaxPower value"
	default 125
	range 0 250
	help
	  bMaxPower value in the configuration in 2 mA units.

config M_USBD_20_EXTENSION_DESC
	bool "Use default USB 2.0 Extension Descriptor"
	depends on USBD_BOS_SUPPORT
	help
	  Set bcdUSB value to 0201 and use default USB 2.0 Extension Descriptor.

endmenu
```

## dts/bindings/m,gpio.yaml
```yaml
## reference yaml file: zephyr/dts/bindings/input/gpio-keys.yaml



# Description of drivers
description: Zephyr Module, M-GPIO

# Compatibility string, matches with DTS and C (DT_DRV_COMPAT m_gpio)
compatible: "m,gpio"

# Define node properties
properties:
    pin:
        type: phandle
        required: true
```

## dts/bindings/m_gpio.yaml
```yaml
## reference yaml file: zephyr/dts/bindings/input/gpio-keys.yaml



# Description of drivers
description: Zephyr Module, M_GPIO

# Compatibility string, matches with DTS and C (DT_DRV_COMPAT m_gpio)
compatible: "m_gpio"

# Define node properties
properties:
    pin:
        type: phandle
        required: true
```

## dts/bindings/mg,button.yaml
```yaml
# Description of drivers
description: MG-Button

# Compatibility string, matches with DTS and C (DT_DRV_COMPAT)
compatible: "mg,button"

# Define node properties
properties:
    pin:
        type: phandle
        required: true
```

## dts/bindings/mz,led.yaml
```yaml
# Description of drivers
description: MZ module, LED

# Compatibility string, match with DTS and C (DT_DRV_COMPAT)
compatible: "mz,led"

# Define node properties
properties:
    pin:
        type: phandle
        required: true
```

## dts/bindings/mz,switch.yaml
```yaml
# Description of drivers
description: MZ module, Switch

# Compatibility string, matches with DTS and C (DT_DRV_COMPAT)
compatible: "mz,switch"

# Define node properties
properties:
    pin:
        type: phandle
        required: true
```
